VERSION ""

NS_ :

BS_:

BU_: ECU

BO_ 256 VehicleStatus: 8 ECU
 SG_ SpeedKph : 0|16@1+ (0.01,0) [0|250] "kph" ECU
 SG_ EngineRpm : 16|16@1+ (1,0) [0|8000] "rpm" ECU

BO_ 257 VehicleCommand: 8 ECU
 SG_ SetSpeedKph : 0|16@1+ (0.01,0) [0|250] "kph" ECU
